## zephyr/Kconfig
```kconfig
# Copyright (c) 2025 WeAct Studio
# SPDX-License-Identifier: Apache-2.0

config ZEPHYR_WEACT_EPAPER_MODULE
	bool

rsource "drivers/display/Kconfig"
```

## zephyr/drivers/display/Kconfig
```kconfig
# Copyright (c) 2025 WeAct Studio
# SPDX-License-Identifier: Apache-2.0

config WEACT_EPAPER
	bool "WeAct Studio E-Paper Display Driver"
	default y
	depends on DT_HAS_WEACT_EPAPER_ENABLED
	depends on SPI
	select GPIO
	help
	  Enable driver for WeAct Studio E-Paper display modules.

	  Supports the following display sizes:
	  - 1.54" (200x200) Black & White
	  - 2.13" (122x250) Black & White
	  - 2.9" (128x296) Black & White / Black & White & Red
	  - 3.7" (240x416) Black & White
	  - 4.2" (400x300) Black & White / Black & White & Red

	  The driver uses SPI for communication with the display controller
	  and requires GPIO pins for reset, data/command selection, and
	  busy status indication.

if WEACT_EPAPER

config WEACT_EPAPER_INIT_PRIORITY
	int "WeAct E-Paper initialization priority"
	default 90
	help
	  Initialization priority for WeAct E-Paper display driver.
	  Must be greater than SPI and GPIO initialization priorities.

endif # WEACT_EPAPER
```

## zephyr_ready_to_compile/dts/bindings/display/weact,epaper.yaml
```yaml
# Copyright (c) 2025 WeAct Studio
# SPDX-License-Identifier: Apache-2.0

description: WeAct Studio E-Paper Display Module

compatible: "weact,epaper"

include: spi-device.yaml

properties:
  reset-gpios:
    type: phandle-array
    required: true
    description: |
      GPIO connected to the display's reset (RES) pin.
      Active low signal.

  dc-gpios:
    type: phandle-array
    required: true
    description: |
      GPIO connected to the display's data/command (DC) pin.
      High = data, Low = command.

  busy-gpios:
    type: phandle-array
    required: true
    description: |
      GPIO connected to the display's busy status pin.
      Used to check when the display is ready.

  width:
    type: int
    required: true
    description: Display width in pixels

  height:
    type: int
    required: true
    description: Display height in pixels

  panel-type:
    type: int
    required: true
    description: |
      E-paper panel type:
      0 = EPD213_219 (2.13" 122x250)
      1 = EPD154 (1.54" 200x200)
      2 = EPD420 (4.2" 400x300)
      3 = EPD370_UC8253 (3.7" 240x416)
    enum:
      - 0  # EPD213_219
      - 1  # EPD154
      - 2  # EPD420
      - 3  # EPD370_UC8253

  color-mode:
    type: string
    default: "bw"
    description: |
      Color mode support:
      "bw" = Black & White only
      "bwr" = Black, White & Red
    enum:
      - "bw"
      - "bwr"

  spi-max-frequency:
    default: 1000000
    description: Maximum SPI clock frequency (default 1MHz)
```
